## components/tc_bus/Kconfig
```kconfig
menu "Bus TC (tc_bus)"
    config TC_BUS_RX_GPIO
        int "GPIO de reception (diviseur)"
        range 0 48
        default 9
    config TC_BUS_TX_GPIO
        int "GPIO d'emission (base du transistor)"
        range 0 48
        default 8
    choice TC_BUS_RX
        prompt "Recepteur du bus"
        default TC_BUS_RX_ADC
        help
            Le bus installe ne descend qu'a ~0.86 V sur la broche RX (repos 2.94 a 2.98 V, diviseur
            1 MOhm / 147 kOhm) : l'entree numerique ne voit pas ces bas de facon fiable, le
            recepteur analogique (ADC) si.
        config TC_BUS_RX_ADC
            bool "ADC continu (analogique, seuils logiciels avec hysteresis)"
        config TC_BUS_RX_RMT
            bool "RMT (entree numerique)"
    endchoice
    config TC_BUS_ADC_LOW_MV
        int "Seuil de passage a bas (mV sur la broche RX)"
        depends on TC_BUS_RX_ADC
        range 200 3000
        default 1700
        help
            Le bus est vu "bas" (mark) quand la broche RX descend sous ce seuil. Mesure sur la
            carte installee : repos 2940 a 2980 mV, point le plus bas d'un telegramme 860 mV.
            Doit rester nettement au-dessus du bas mesure et sous TC_BUS_ADC_HIGH_MV.
    config TC_BUS_ADC_HIGH_MV
        int "Seuil de retour a haut (mV sur la broche RX)"
        depends on TC_BUS_RX_ADC
        range 200 3000
        default 2100
        help
            Le bus redevient "haut" (repos) quand la broche RX remonte a ce seuil ou au-dessus.
            Mesure : repos 2940 a 2980 mV, bas 860 mV. L'ecart avec TC_BUS_ADC_LOW_MV
            (hysteresis) evite les fronts parasites dans le bruit ; il doit rester sous le repos.
    config TC_BUS_ADC_SAMPLE_HZ
        int "Cadence d'echantillonnage de l'ADC (Hz)"
        depends on TC_BUS_RX_ADC
        range 10000 40000
        default 20000
        help
            20 kHz : un echantillon toutes les 50 us, largement assez pour des fenetres de bits
            de +-1000 us et un depart de 5700 a 6089 us.
    config TC_BUS_TX_ENABLE
        bool "Compiler l'emission (DOIT rester desactive en phase 0)"
        default n
    config TC_BUS_GLITCH_US
        int "Segments plus courts que ceci sont des parasites (us)"
        range 100 2000
        default 1000
    config TC_BUS_MY_SERIAL
        hex "Numero de serie de la station interieure (20 bits)"
        range 0x0 0xFFFFF
        default 0x0
        help
            Numero de serie 20 bits (0x00000..0xFFFFF) de la station interieure de l'appartement.
            Les telegrammes qui la concernent sont marques "<< POUR MOI" dans les logs et comptes
            dans /info. 0 = inconnu : aucun repere. Pour le relever, sonner depuis la platine
            et lire le champ serial du DOOR_CALL (docs/utilisation.md, section 7).
    config TC_BUS_DOOR_ADDRESS
        int "Adresse de la platine de rue (0..63)"
        range 0 63
        default 0
        help
            Adresse de la platine de rue. Un OPEN_DOOR court ne porte pas de numero de serie :
            il n'est marque "pour moi" que s'il vise cette adresse et suit de moins de 3 minutes
            un appel pour moi.
endmenu
```

## main/Kconfig.projbuild
```kconfig
menu "Interphone"

    menu "Wi-Fi"
        config APP_WIFI_SSID
            string "SSID (2.4 GHz)"
            default ""
        config APP_WIFI_PASSWORD
            string "Mot de passe Wi-Fi"
            default ""
        config APP_HOSTNAME
            string "Nom d'hote mDNS (<nom>.local)"
            default "interphone"
        config APP_WIFI_TX_POWER
            int "Puissance d'emission max (unites de 0.25 dBm, 52 = 13 dBm)"
            range 8 84
            default 52
        config APP_RECOVERY_AP_PASSWORD
            string "Mot de passe du SoftAP de secours (>= 8 caracteres, vide = desactive)"
            default ""
        config APP_RECOVERY_AP_DELAY_S
            int "Delai sans connexion avant SoftAP de secours (s)"
            range 30 86400
            default 600
    endmenu

    menu "Logs reseau"
        config APP_NETLOG_ENABLE
            bool "Serveur de logs TCP"
            default y
        config APP_NETLOG_PORT
            int "Port TCP des logs"
            depends on APP_NETLOG_ENABLE
            default 3333
        config APP_NETLOG_BUFFER_KB
            int "Tampon circulaire (Ko)"
            depends on APP_NETLOG_ENABLE
            range 4 32
            default 12
    endmenu

    menu "OTA et auto-test"
        config APP_HTTP_PORT
            int "Port du serveur HTTP (OTA, info)"
            default 8080
        config APP_OTA_TOKEN
            string "Token OTA (>= 32 caracteres, openssl rand -hex 24)"
            default ""
        config APP_SELFTEST_TIMEOUT_S
            int "Delai max de l'auto-test (s)"
            range 10 3600
            default 90
        config APP_SELFTEST_FORCE_FAIL
            bool "TEST UNIQUEMENT : forcer l'echec de l'auto-test"
            default n
        config APP_BENCH_TEST
            bool "TEST SUR L'ETABLI UNIQUEMENT : autorise auto-test >= delai du SoftAP"
            default n
            help
                Leve le garde-fou de compilation qui exige un auto-test plus court que le
                delai du SoftAP de secours. Sert uniquement a tester le SoftAP sur l'etabli
                avec des delais courts (ex. 60 s / 180 s). Ne JAMAIS activer dans une image
                qui sera installee : une image sans Wi-Fi fonctionnel serait validee par le
                SoftAP et l'acces distant ne reviendrait qu'en passant par lui.
    endmenu

    config APP_HEARTBEAT_S
        int "Periode du battement de coeur dans les logs (s, 0 = desactive)"
        range 0 3600
        default 300

endmenu
```
